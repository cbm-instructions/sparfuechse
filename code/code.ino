#include "max6675.h"
#include <SPI.h>
#include <Wire.h>
#include "SPI.h"
#include "TFT_22_ILI9225.h"
#include <Adafruit_NeoPixel.h>
#include <EEPROM.h>

#define TFT_LED 0
#define TFT_CS  8
#define TFT_RST 9
#define TFT_RS  10
#define TFT_SDI 11
#define TFT_CLK 12

#define TFT_BRIGHTNESS 200

TFT_22_ILI9225 tft = TFT_22_ILI9225(TFT_RST, TFT_RS, TFT_CS, TFT_SDI, TFT_CLK, TFT_LED, TFT_BRIGHTNESS);

Adafruit_NeoPixel strip = Adafruit_NeoPixel(60, 7, NEO_GRB + NEO_KHZ800);

// Sensors port declaration
int thermoCLK = 4;
int thermoCS = 5;
int thermoDO = 6;
int flow = 2;

MAX6675 thermocouple(thermoCLK, thermoCS, thermoDO);

// Constants
const int logInterval = 1000;
const float impulsesPerLiter = 200.00;
const float pricePerkWh = 0.10; // in Euros
const float pricePerLiter = 0.002; // in Euros
const float baseTemperatureK = 288.15; // 15 degrees Celsius

const uint8_t PROGMEM thermometerIcon[] = {
  0x00, 0x00, 0x0f, 0x80, 0x00, 0x00, 0x00, 0x00, 0x00, 0x3f, 0xc0, 0x00, 0x00, 0x00, 0x00, 0x00,
  0x7f, 0xe0, 0x00, 0x00, 0x00, 0x00, 0x00, 0xf0, 0xf0, 0x00, 0x00, 0x00, 0x00, 0x01, 0xe0, 0x78,
  0x00, 0x00, 0x00, 0x00, 0x01, 0xc0, 0x38, 0x00, 0x00, 0x00, 0x00, 0x01, 0xc0, 0x38, 0x7f, 0x00,
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  0x00, 0x00, 0xff, 0xf0, 0x00, 0x00, 0x00, 0x00, 0x00, 0x1f, 0x80, 0x00, 0x00, 0x00
};

const uint8_t PROGMEM waterIcon[] = {
  0x00, 0x00, 0x00, 0x00, 0x00, 0x00, 0x00, 0x00, 0x00, 0x00, 0xc0, 0x00, 0x00, 0x00, 0x00, 0x00,
  0x01, 0xe0, 0x00, 0x00, 0x00, 0x00, 0x00, 0x03, 0xf0, 0x00, 0x00, 0x00, 0x00, 0x00, 0x03, 0xf0,
  0x00, 0x00, 0x00, 0x00, 0x00, 0x07, 0xb8, 0x00, 0x00, 0x00, 0x00, 0x00, 0x0f, 0x3c, 0x00, 0x00,
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  0x07, 0xff, 0xf8, 0x07, 0xff, 0xf8, 0x00, 0x00, 0x7f, 0xc0, 0x00, 0x7f, 0x80, 0x00
};

const uint8_t PROGMEM remainingIcon[] = {
  0x00, 0x00, 0x01, 0xfc, 0x00, 0x00, 0x00, 0x00, 0x00, 0x01, 0xff, 0x80, 0x00, 0x00, 0x00, 0x00,
  0x01, 0xff, 0xf0, 0x00, 0x00, 0x00, 0x00, 0x01, 0xff, 0xfc, 0x00, 0x00, 0x00, 0x00, 0x0f, 0xe3,
  0xfe, 0x00, 0x00, 0x00, 0x00, 0x1f, 0xe0, 0x7f, 0x80, 0x00, 0x00, 0x00, 0x1f, 0xe0, 0x1f, 0xc0,
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  0x00, 0x00, 0x7f, 0xff, 0xc0, 0x00, 0x00, 0x00, 0x00, 0x0f, 0xfc, 0x00, 0x00, 0x00
};

// Runtime variables
int eeAddress = 0;
int eeUnitSize = sizeof(float);
boolean eeUsedBudgetSavedInitial = false;
unsigned long previousMillis = 0;
unsigned long currentMillis = 0;
int impulses = 0;
float volumeInLiter = 0.00;
float volumeInLiterPerMinute = 0.00;
float temperatureC = 0.00;
float temperatureK = 0.00;
float availableBudget = 0.00; // in Euros
float usedBudget = 0.00; // in Euros
float remainingBudget = 0.00; // in Euros
int ringPos = 0;
float valuePerLED = 0.00;

void setup() {
  Serial.begin(9600);
  
  pinMode(flow, INPUT);
  attachInterrupt(digitalPinToInterrupt(flow), pin_ISR, RISING);

  calculateAvailableBudget();
  remainingBudget = availableBudget;

  tft.begin();
  tft.setFont(Terminal12x16);
  printToDisplay();

  valuePerLED = availableBudget / 24;
  strip.setBrightness(50);
  strip.begin();
  strip.show();
  initGreen();
}

void loop() {
  currentMillis = millis();

  if (currentMillis - previousMillis >= logInterval) {
    
    if (impulses == 0) {
      saveUsedBudget();
    }
    
    temperatureC = thermocouple.readCelsius();
    temperatureK = temperatureC + 273.15;
    volumeInLiter = impulses / impulsesPerLiter;
    volumeInLiterPerMinute = volumeInLiter * 60;

    float consumptionInkWh = 2.5 * (volumeInLiter / 1000) * (temperatureK - baseTemperatureK);
    float consumptionInEuro = (consumptionInkWh * pricePerkWh) + (volumeInLiter * pricePerLiter);
    usedBudget = usedBudget + consumptionInEuro;
    
    remainingBudget = availableBudget - usedBudget;
    
    printToDisplay();

    if (usedBudget / valuePerLED > ringPos && remainingBudget > -0.001) {
      decrDial();
    } else if (usedBudget / valuePerLED > ringPos && remainingBudget <= -0.001) {
      incrDial();
    }

    resetInterval();
  }
}

void calculateAvailableBudget() {
  eeAddress = 0;
  float sum = 0.00;
  int numberOfValues = 0;
  float currentValue = 0.00;
  EEPROM.get(eeAddress, currentValue);

  if (isnan(currentValue) == 0 && currentValue != 0) {
    sum += currentValue;
    numberOfValues = 1;

    for (int i = 1; i < 10; i++) {
      eeAddress += eeUnitSize;
      EEPROM.get(eeAddress, currentValue);

      if (isnan(currentValue) == 0 && currentValue != 0) {
        sum += currentValue;
        numberOfValues += 1;
      } else {
        break;
      }
    }

    availableBudget = sum / numberOfValues;
  } else {
    availableBudget = 0.50f; // Set initial budget for first usage
  }
}

void saveUsedBudget() {
  if (!eeUsedBudgetSavedInitial && usedBudget != 0) {
    eeAddress = 0;
    float currentValue = 0.00;
    float previousValue = 0.00;
    EEPROM.get(eeAddress, previousValue);

    for (int i = 1; i < 10; i++) {
      eeAddress += eeUnitSize;
      EEPROM.get(eeAddress, currentValue);
      if (isnan(previousValue) == 0 && previousValue != 0) {
        EEPROM.put(eeAddress, previousValue);
        previousValue = currentValue;
      } else {
        break;
      }
    }

    eeAddress = 0;
    EEPROM.put(eeAddress, usedBudget);
    eeUsedBudgetSavedInitial = true;
  } else if (eeUsedBudgetSavedInitial && usedBudget != 0) {
    eeAddress = 0;
    EEPROM.put(eeAddress, usedBudget);
  }
}

void initGreen() {
  colorWipe(strip.Color(0, 255, 0), 50);
  strip.show();
}

void colorWipe(uint32_t c, uint8_t wait) {
  for (uint16_t i = 0; i < strip.numPixels(); i++) {
    strip.setPixelColor(i, c);
    strip.show();
    delay(wait);
  }
}

void decrDial() {
  const int ledsToDecr = round(usedBudget / valuePerLED) - ringPos;

  for (int i = ringPos; i <= (ringPos + ledsToDecr - 1); i++) {
    strip.setPixelColor(i, 0, 0, 0);
  }
  
  if (ringPos + ledsToDecr > 11) {
    for (int i = ringPos + ledsToDecr; i <= 23; i++) {
      strip.setPixelColor(i, 255, 165, 0);
    }
  }
  
  if (ringPos + ledsToDecr > 17) {
    for (int i = ringPos + ledsToDecr; i <= 23; i++) {
      strip.setPixelColor(i, 255, 0, 0);
    }
  }
  
  strip.show();
  ringPos += ledsToDecr;
}

void incrDial() {
  const int ringPosTmp = ringPos - 24;
  const int ledsToIncr = round(usedBudget / valuePerLED) - ringPos;

  Serial.println(ringPosTmp);
  Serial.println(ledsToIncr);
  Serial.println();
  
  for (int i = ringPosTmp; i <= (ringPosTmp + ledsToIncr - 1); i++) {
    strip.setPixelColor(i, 255, 0, 0);
  }
  
  strip.show();
  ringPos += ledsToIncr;
}

void printToDisplay() {
  tft.drawBitmap(23, 15, thermometerIcon, 50, 50, COLOR_WHITE);
  tft.drawText(85, 25, String(round(temperatureC * 100) / 100));
  tft.drawText(85, 45, "Grad C");

  tft.drawBitmap(20, 85, waterIcon, 50, 50, COLOR_WHITE);
  tft.drawText(85, 92, String(round(volumeInLiterPerMinute * 100) / 100));
  tft.drawText(85, 112, "l/min");

  tft.drawBitmap(20, 155, remainingIcon, 50, 50, COLOR_WHITE);
  tft.drawText(85, 163, String(round(remainingBudget * 100) / 100));
  tft.drawText(85, 183, "Euro");
}

void serialPrint() {
  Serial.print("Temperature = ");
  Serial.print(temperatureC);
  Serial.println(" °C");

  Serial.print("Volume = ");
  Serial.print(volumeInLiterPerMinute);
  Serial.println(" l/min");

  Serial.print("Used budget = ");
  Serial.print(usedBudget);
  Serial.println(" €");

  Serial.print("Remaining budget = ");
  Serial.print(remainingBudget);
  Serial.println(" €");

  Serial.println();
}

void resetInterval() {
  impulses = 0;
  previousMillis = currentMillis;
}

void pin_ISR() {
  impulses += 1;
}

void resetEERPOMMemory() {
  for (int i = 0 ; i < EEPROM.length() ; i++) {
    EEPROM.write(i, 0);
  }
}
